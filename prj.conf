## CMakeLists.txt
```
cmake_minimum_required(VERSION 3.20.0)

find_package(Zephyr REQUIRED HINTS $ENV{ZEPHYR_BASE})
project(rpi_pico_st7789_blinky)

target_sources(app PRIVATE src/main.c
                           src/clock.h
                           src/clock.c
                           src/led.h
                           src/led.c
                           src/display.h
                           src/display.c
                           src/char_utils.h
                           )
```

## prj.conf
```kconfig
CONFIG_GPIO=y

CONFIG_SPI=y

CONFIG_LOG=y
CONFIG_LOG_DEFAULT_LEVEL=3

CONFIG_PRINTK=y
CONFIG_CONSOLE=y
CONFIG_UART_CONSOLE=y

CONFIG_NEWLIB_LIBC=y

CONFIG_DISPLAY=y

CONFIG_MAIN_STACK_SIZE=4096
CONFIG_HEAP_MEM_POOL_SIZE=160000
```

## boards/stm32f429i_disc1.overlay
```dts
  #include <zephyr/dt-bindings/input/input-event-codes.h>

/{
  buttons {
    compatible = "gpio-keys";
      button_0 {
        gpios = <&gpio2 1 (GPIO_PULL_DOWN | GPIO_ACTIVE_HIGH)>;
	  };
	};
 };
```

## src/main.c
```c
#include "clock.h"
#include "led.h"
#include "display.h"

int main(void)
{
    display_setup();
    clock_setup();
    led_setup();

    return 0;
}
```

## src/char_utils.h
```c
#ifndef CHAR_UTILS_H
#define CHAR_UTILS_H

struct char_with_width {
    uint8_t *data;
    uint8_t width;
};

#endif
```

## src/characters.h
```c
#include <stdint.h>
#include "char_utils.h"

uint8_t ZERO[] = {0x00, 0xff, 0xff, 0xff, 0xff, 0xff, 0x00,
                   0xff, 0xff, 0x00, 0x00, 0x00, 0xff, 0xff,
                   0xff, 0x00, 0x00, 0x00, 0x00, 0x00, 0xff,
                   0xff, 0x00, 0x00, 0x00, 0x00, 0x00, 0xff,
                   0xff, 0x00, 0x00, 0x00, 0x00, 0x00, 0xff,
                   0xff, 0x00, 0x00, 0x00, 0x00, 0x00, 0xff,
                   0xff, 0x00, 0x00, 0x00, 0x00, 0x00, 0xff,
                   0xff, 0x00, 0x00, 0x00, 0x00, 0x00, 0xff,
                   0xff, 0xff, 0x00, 0x00, 0x00, 0xff, 0xff,
                   0x00, 0xff, 0xff, 0xff, 0xff, 0xff, 0x00};

uint8_t ONE[] = { 0x00, 0x00, 0x00, 0x00, 0x00, 0xff, 0x00,
                  0x00, 0x00, 0x00, 0x00, 0xff, 0xff, 0x00,
                  0x00, 0x00, 0x00, 0xff, 0x00, 0xff, 0x00,
                  0x00, 0x00, 0xff, 0x00, 0x00, 0xff, 0x00,
                  0x00, 0xff, 0x00, 0x00, 0x00, 0xff, 0x00,
                  0xff, 0x00, 0x00, 0x00, 0x00, 0xff, 0x00,
                  0x00, 0x00, 0x00, 0x00, 0x00, 0xff, 0x00,
                  0x00, 0x00, 0x00, 0x00, 0x00, 0xff, 0x00,
                  0x00, 0x00, 0x00, 0x00, 0x00, 0xff, 0x00,
                  0x00, 0x00, 0x00, 0x00, 0x00, 0xff, 0x00};

uint8_t TWO[] = {0x00, 0xff, 0xff, 0xff, 0xff, 0xff, 0x00,
                  0xff, 0xff, 0x00, 0x00, 0x00, 0xff, 0xff,
                  0xff, 0x00, 0x00, 0x00, 0x00, 0x00, 0xff,
                  0x00, 0x00, 0x00, 0x00, 0x00, 0x00, 0xff,
                  0x00, 0x00, 0x00, 0x00, 0x00, 0xff, 0xff,
                  0x00, 0x00, 0x00, 0xff, 0xff, 0xff, 0x00,
                  0x00, 0x00, 0xff, 0xff, 0x00, 0x00, 0x00,
                  0x00, 0xff, 0xff, 0x00, 0x00, 0x00, 0x00,
                  0xff, 0xff, 0x00, 0x00, 0x00, 0xff, 0xff,
                  0xff, 0xff, 0xff, 0xff, 0xff, 0xff, 0xff};

uint8_t THREE[] = {0x00, 0xff, 0xff, 0xff, 0xff, 0xff, 0x00,
                    0xff, 0xff, 0x00, 0x00, 0x00, 0xff, 0xff,
                    0x00, 0x00, 0x00, 0x00, 0x00, 0x00, 0xff,
                    0x00, 0x00, 0x00, 0x00, 0x00, 0x00, 0xff,
                    0x00, 0x00, 0xff, 0xff, 0xff, 0xff, 0x00,
                    0x00, 0x00, 0xff, 0xff, 0xff, 0xff, 0x00,
                    0x00, 0x00, 0x00, 0x00, 0x00, 0x00, 0xff,
                    0x00, 0x00, 0x00, 0x00, 0x00, 0x00, 0xff,
                    0xff, 0xff, 0x00, 0x00, 0x00, 0xff, 0xff,
                    0x00, 0xff, 0xff, 0xff, 0xff, 0xff, 0x00};

uint8_t FOUR[] = {0x00, 0x00, 0x00, 0x00, 0x00, 0xff, 0x00,
                   0x00, 0x00, 0x00, 0x00, 0xff, 0xff, 0x00,
                   0x00, 0x00, 0x00, 0xff, 0x00, 0xff, 0x00,
                   0x00, 0x00, 0xff, 0x00, 0x00, 0xff, 0x00,
                   0x00, 0xff, 0x00, 0x00, 0x00, 0xff, 0x00,
                   0xff, 0x00, 0x00, 0x00, 0x00, 0xff, 0x00,
                   0xff, 0xff, 0xff, 0xff, 0xff, 0xff, 0xff,
                   0x00, 0x00, 0x00, 0x00, 0x00, 0xff, 0x00,
                   0x00, 0x00, 0x00, 0x00, 0x00, 0xff, 0x00,
                   0x00, 0x00, 0x00, 0x00, 0x00, 0xff, 0x00};

uint8_t FIVE[] = {0xff, 0xff, 0xff, 0xff, 0xff, 0xff, 0xff,
                   0xff, 0xff, 0x00, 0x00, 0x00, 0x00, 0x00,
                   0xff, 0x00, 0x00, 0x00, 0x00, 0x00, 0x00,
                   0xff, 0x00, 0x00, 0x00, 0x00, 0x00, 0x00,
                   0xff, 0xff, 0xff, 0xff, 0xff, 0xff, 0x00,
                   0x00, 0x00, 0x00, 0x00, 0x00, 0xff, 0xff,
                   0x00, 0x00, 0x00, 0x00, 0x00, 0x00, 0xff,
                   0x00, 0x00, 0x00, 0x00, 0x00, 0x00, 0xff,
                   0xff, 0xff, 0x00, 0x00, 0x00, 0xff, 0xff,
                   0x00, 0xff, 0xff, 0xff, 0xff, 0xff, 0x00};

uint8_t SIX[] = {0x00, 0x00, 0xff, 0xff, 0xff, 0xff, 0x00,
                  0x00, 0xff, 0xff, 0x00, 0x00, 0x00, 0x00,
                  0xff, 0xff, 0x00, 0x00, 0x00, 0x00, 0x00,
                  0xff, 0x00, 0x00, 0x00, 0x00, 0x00, 0x00,
                  0xff, 0xff, 0xff, 0xff, 0xff, 0xff, 0x00,
                  0xff, 0xff, 0x00, 0x00, 0x00, 0xff, 0xff,
                  0xff, 0x00, 0x00, 0x00, 0x00, 0x00, 0xff,
                  0xff, 0x00, 0x00, 0x00, 0x00, 0x00, 0xff,
                  0xff, 0xff, 0x00, 0x00, 0x00, 0xff, 0xff,
                  0x00, 0xff, 0xff, 0xff, 0xff, 0xff, 0x00};

uint8_t SEVEN[] = {0xff, 0xff, 0xff, 0xff, 0xff, 0xff, 0xff,
                    0xff, 0xff, 0x00, 0x00, 0x00, 0xff, 0xff,
                    0x00, 0x00, 0x00, 0x00, 0x00, 0xff, 0x00,
                    0x00, 0x00, 0x00, 0x00, 0xff, 0x00, 0x00,
                    0x00, 0x00, 0x00, 0xff, 0x00, 0x00, 0x00,
                    0x00, 0x00, 0xff, 0x00, 0x00, 0x00, 0x00,
                    0x00, 0xff, 0x00, 0x00, 0x00, 0x00, 0x00,
                    0xff, 0x00, 0x00, 0x00, 0x00, 0x00, 0x00,
                    0xff, 0x00, 0x00, 0x00, 0x00, 0x00, 0x00,
                    0xff, 0x00, 0x00, 0x00, 0x00, 0x00, 0x00};

uint8_t EIGHT[] = {0x00, 0xff, 0xff, 0xff, 0xff, 0xff, 0x00,
                    0xff, 0xff, 0x00, 0x00, 0x00, 0xff, 0xff,
                    0xff, 0x00, 0x00, 0x00, 0x00, 0x00, 0xff,
                    0xff, 0x00, 0x00, 0x00, 0x00, 0x00, 0xff,
                    0xff, 0x00, 0x00, 0x00, 0x00, 0x00, 0xff,
                    0x00, 0xff, 0xff, 0xff, 0xff, 0xff, 0x00,
                    0xff, 0x00, 0x00, 0x00, 0x00, 0x00, 0xff,
                    0xff, 0x00, 0x00, 0x00, 0x00, 0x00, 0xff,
                    0xff, 0xff, 0x00, 0x00, 0x00, 0xff, 0xff,
                    0x00, 0xff, 0xff, 0xff, 0xff, 0xff, 0x00};

uint8_t NINE[] = {0x00, 0xff, 0xff, 0xff, 0xff, 0xff, 0x00,
                   0xff, 0xff, 0x00, 0x00, 0x00, 0xff, 0xff,
                   0xff, 0x00, 0x00, 0x00, 0x00, 0x00, 0xff,
                   0xff, 0x00, 0x00, 0x00, 0x00, 0x00, 0xff,
                   0xff, 0xff, 0x00, 0x00, 0x00, 0xff, 0xff,
                   0x00, 0xff, 0xff, 0xff, 0xff, 0xff, 0xff,
                   0x00, 0x00, 0x00, 0x00, 0x00, 0x00, 0xff,
                   0x00, 0x00, 0x00, 0x00, 0x00, 0xff, 0xff,
                   0x00, 0x00, 0x00, 0xff, 0xff, 0xff, 0x00,
                   0x00, 0xff, 0xff, 0xff, 0xff, 0x00, 0x00};

uint8_t COLON[] = {0x00,
                   0x00,
                   0x00,
                   0xff,
                   0x00,
                   0x00,
                   0xff,
                   0x00,
                   0x00,
                   0x00
};

uint8_t NO_COLON[] = {0x00,
                   0x00,
                   0x00,
                   0x00,
                   0x00,
                   0x00,
                   0x00,
                   0x00,
                   0x00,
                   0x00
};

struct char_with_width chars[] = {
    {.data = ZERO, .width = 7},
    {.data = ONE, .width = 7},
    {.data = TWO, .width = 7},
    {.data = THREE, .width = 7},
    {.data = FOUR, .width = 7},
    {.data = FIVE, .width = 7},
    {.data = SIX, .width = 7},
    {.data = SEVEN, .width = 7},
    {.data = EIGHT, .width = 7},
    {.data = NINE, .width = 7},
    {.data = COLON, .width = 1},
    {.data = NO_COLON, .width = 1}
};
```

## src/clock.c
```c
#include <zephyr/devicetree.h>
#include <zephyr/kernel.h>
#include "clock.h"
#include <zephyr/logging/log.h>
#include <zephyr/device.h>
#include <zephyr/drivers/display.h>

#include <zephyr/drivers/gpio.h>

#include "display.h"
#include "characters.h"

LOG_MODULE_REGISTER(clock);

#define STACKSIZE 4096
#define PRIORITY 7

#define COLON_IDX 10
#define NO_COLON_IDX 11

K_THREAD_STACK_DEFINE(clock_stack_area, STACKSIZE);
struct k_thread clock_thread_data;

const struct device *TEST_gpio_dev = DEVICE_DT_GET(DT_NODELABEL(gpioc));


static void clock_timer_handler(){
    uint32_t uptime;
    uint8_t minutes, seconds;
    while (1){

        uptime = k_uptime_seconds();
        minutes = (uptime / 60) % 100;
        seconds = uptime - (int)(uptime / 60) * 60;

        display_draw_character(0, &chars[minutes / 10]);
        display_draw_character(1, &chars[minutes % 10]);
        display_draw_character(2, &chars[COLON_IDX]);
        display_draw_character(3, &chars[seconds / 10]);
        display_draw_character(4, &chars[seconds % 10]);

        k_msleep(500);

        display_draw_character(2, &chars[NO_COLON_IDX]);
        k_msleep(500);
        LOG_INF("gpio value: %d", gpio_pin_get(TEST_gpio_dev, 1));
    }
}


void clock_setup(void){
    gpio_pin_configure(TEST_gpio_dev, 1, GPIO_INPUT);
    k_thread_create(&clock_thread_data, clock_stack_area, K_THREAD_STACK_SIZEOF(clock_stack_area),
                    clock_timer_handler, NULL, NULL, NULL, PRIORITY, 0, K_NO_WAIT);
}
```

## src/clock.h
```c
void clock_setup(void);
```

## src/display.c
```c
#include "display.h"
#include <zephyr/device.h>
#include <zephyr/drivers/display.h>
#include <zephyr/logging/log.h>

LOG_MODULE_REGISTER(display);

#define BUFFER_WIDTH 100
#define BUFFER_HEIGHT 10

const struct device *display_dev;
struct display_buffer_descriptor *buf_desc;

static int CHAR_POSITIONS[] = {5, 80, 155, 170, 245};

static void *buf;

static void display_blank_whole_screen(){
    memset(buf, 0, BUFFER_HEIGHT * BUFFER_WIDTH * sizeof(uint16_t));
    for (size_t row = 0; row < 320; row += BUFFER_HEIGHT) {
        for (size_t col = 0; col < 240; col += BUFFER_WIDTH) {
            display_write(display_dev, col, row, buf_desc, buf);
        }
    }
}

void display_setup(){
    display_dev = DEVICE_DT_GET(DT_CHOSEN(zephyr_display));
    if (!device_is_ready(display_dev)) {
        LOG_ERR("Display is not ready, hmmm");
        return;
    }

    buf_desc = k_calloc(1, sizeof(struct display_buffer_descriptor));

    buf_desc->height = BUFFER_HEIGHT;
    buf_desc->width = BUFFER_WIDTH;
    buf_desc->frame_incomplete = false;
    buf_desc->pitch = BUFFER_WIDTH;
    buf_desc->buf_size = BUFFER_HEIGHT * BUFFER_WIDTH * sizeof(uint16_t);

    buf = k_calloc(BUFFER_WIDTH * BUFFER_HEIGHT, sizeof(uint16_t));
    if (!buf){
        LOG_ERR("Not enough memory!");
        return;
    }

    display_blank_whole_screen();

    display_blanking_off(display_dev);
}


/**
 * Calculate the color that should be displayed at a position in
 * the framebuffer. It scales the buffer to character size,
 * and depending on the current slice, it returns the corresponding 
 * character color value.
 */
static inline uint16_t display_color_at_position(uint8_t char_slice, int buf_col, int buf_row, struct char_with_width *character){
    uint16_t color;
    uint8_t scaled_col, scaled_row;
    // switch col and row - the framebuffer is portrait, but
    // the screen is in landscape.
    scaled_row = (char_slice * 10 + buf_col) / 10;
    // the screen is upside down, so render it also upside down
    // bottom row at the top
    scaled_col = (9 - buf_row / 10) * character->width;
    color = character->data[scaled_col + scaled_row];
    return color;
}

/**
 * Fills the buffer with the scaled color values of the slice of the character.
 * A slice is a scaled column of pixels.
 */
static inline void display_fill_buffer(uint8_t char_slice, struct char_with_width *character){
    uint16_t color;

    for (int buf_row = 0; buf_row < BUFFER_WIDTH; ++buf_row){
        for (int buf_col = 0; buf_col < BUFFER_HEIGHT; ++buf_col){
            color = display_color_at_position(char_slice, buf_col, buf_row, character);
            memset((uint16_t*)buf + (buf_col * 100 + buf_row), color, sizeof(uint16_t));
        }
    }
}

/**
 * Draw a character bitmap on the screen at a given position.
 * The third, middle position is narrow, only 10 pixels wide.
 * Positions 1, 2, 4, and 5 are 70 pixels wide.
 * 
 * For now display text only in the middle of the screen.
 */
void display_draw_character(uint8_t position, struct char_with_width *character){
    for (int char_slice = 0; char_slice < character->width; ++char_slice){
        display_fill_buffer(char_slice, character);
        display_write(display_dev, 80, CHAR_POSITIONS[position] + char_slice * 10, buf_desc, buf);
    }
}
```

## src/display.h
```c
#include <stdint.h>
#include "char_utils.h"

void display_setup();
void display_draw_character(uint8_t position, struct char_with_width *character);
```

## src/led.c
```c
#include "led.h"
#include <zephyr/drivers/gpio.h>
#include <zephyr/devicetree.h>
#include <zephyr/logging/log.h>

LOG_MODULE_REGISTER(led);

#define SLEEP_TIME_MS 1000
#define LED0_NODE DT_ALIAS(led0)

/* size of stack area used by each thread */
#define STACKSIZE 4096

/* scheduling priority used by each thread */
#define PRIORITY 7

K_THREAD_STACK_DEFINE(led_stack_area, STACKSIZE);
struct k_thread led_thread_data;

static const struct gpio_dt_spec led = GPIO_DT_SPEC_GET(LED0_NODE, gpios);

void led_thread(void){
    int ret;
    while (1) {
        ret = gpio_pin_toggle_dt(&led);
        if (ret < 0) {
            LOG_ERR("Failed to toggle LED: %d", ret);
            return;
        }

        if (ret < 0) {
            LOG_ERR("Failed to toggle backlight: %d", ret);
            return;
        }

        /* Sleep for specified time */
        k_msleep(SLEEP_TIME_MS);
    }
}

void led_setup(void){
    int ret;
    if (!gpio_is_ready_dt(&led)) {
        LOG_ERR("LED device %s is not ready", led.port->name);
        return;
    }

    ret = gpio_pin_configure_dt(&led, GPIO_OUTPUT_ACTIVE);
    if (ret < 0) {
        LOG_ERR("Failed to configure LED pin: %d", ret);
        return;
    }

    k_thread_create(&led_thread_data, led_stack_area, K_THREAD_STACK_SIZEOF(led_stack_area),
                led_thread, NULL, NULL, NULL, PRIORITY, 0, K_NO_WAIT);
}
```

## src/led.h
```c
void led_setup(void);
```
